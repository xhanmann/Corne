#include "corne.dtsi"

&default_transform {
    col-offset = <6>;
};

&kscan0 {
    col-gpios = <&pro_micro 6 GPIO_ACTIVE_HIGH>,
                <&pro_micro 7 GPIO_ACTIVE_HIGH>,
                <&pro_micro 9 GPIO_ACTIVE_HIGH>,
                <&pro_micro 8 GPIO_ACTIVE_HIGH>,
                <&pro_micro 16 GPIO_ACTIVE_HIGH>,
                <&pro_micro 14 GPIO_ACTIVE_HIGH>;
};

&i2c0 {
    status = "okay";
    /* add a node label so &ssd1306 references work */
    ssd1306: ssd1306@3c {
        compatible = "solomon,ssd1306";
        reg = <0x3C>;
        label = "SSD1306";
        width = <128>;
        height = <64>;
        segment-offset = <0>;
        page-offset = <0>;
        reset-gpios = <&gpio0 16 (GPIO_ACTIVE_LOW)>;  // flags must be in parentheses
        status = "okay";
    };
};
