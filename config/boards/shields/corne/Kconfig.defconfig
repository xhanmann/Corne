## config/boards/shields/corne/Kconfig.defconfig
```kconfig
if SHIELD_CORNE_LEFT

config ZMK_KEYBOARD_NAME
    default "Corne"

config ZMK_SPLIT_ROLE_CENTRAL
    default y

endif

if SHIELD_CORNE_LEFT || SHIELD_CORNE_RIGHT

config ZMK_SPLIT
    default y

endif

if ZMK_DISPLAY

config I2C
    default y

config SSD1306
    default y

endif

if ZMK_BACKLIGHT

config ZMK_BACKLIGHT_BRT_STEP
    default 20

config ZMK_BACKLIGHT_BRT_START
    default 40

config ZMK_BACKLIGHT_ON_START
    default y

config PWM
    default y

config LED_PWM
    default y

endif # ZMK_BACKLIGHT
if ZMK_RGB_UNDERGLOW

config ZMK_RGB_UNDERGLOW
    default y

config ZMK_RGB_UNDERGLOW_NUM
    default 10

config ZMK_RGB_UNDERGLOW_EFFECT_BREATHING
    default y

config ZMK_RGB_UNDERGLOW_EFFECT_RAINBOW
    default y

config ZMK_RGB_UNDERGLOW_BRIGHTNESS
    default 128

config ZMK_RGB_UNDERGLOW_DEFAULT_EFFECT
    default "rainbow"

config ZMK_RGB_UNDERGLOW_KEYPRESS
    default y

config WS2812_STRIP
    default y

config WS2812_PIN
    default 0

endif
```

## config/boards/shields/corne/Kconfig.shield
```kconfig
config SHIELD_CORNE_LEFT
    def_bool $(shields_list_contains, mcorne_left)

config SHIELD_CORNE_RIGHT
    def_bool $(shields_list_contains, mcorne_right)
```
