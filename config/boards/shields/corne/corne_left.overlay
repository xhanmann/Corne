#include "corne.dtsi"

&kscan0 {
    col-gpios = <&pro_micro 6  (GPIO_ACTIVE_HIGH | GPIO_PULL_DOWN)>,
                <&pro_micro 7  (GPIO_ACTIVE_HIGH | GPIO_PULL_DOWN)>,
                <&pro_micro 9  (GPIO_ACTIVE_HIGH | GPIO_PULL_DOWN)>,
                <&pro_micro 8  (GPIO_ACTIVE_HIGH | GPIO_PULL_DOWN)>,
                <&pro_micro 16 (GPIO_ACTIVE_HIGH | GPIO_PULL_DOWN)>,
                <&pro_micro 14 (GPIO_ACTIVE_HIGH | GPIO_PULL_DOWN)>;
};

&i2c0 {
    status = "okay";
    /* add a node label so &ssd1306 references work */
   
    };
};
