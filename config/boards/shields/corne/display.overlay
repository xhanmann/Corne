/ {
    i2c1: i2c@40003000 {
        compatible = "nordic,nrf-twim";
        status = "okay";
        sda-pin = <3>; /* Adjust to your SDA pin */
        scl-pin = <4>; /* Adjust to your SCL pin */
        clock-frequency = <I2C_BITRATE_FAST>;
        
        ssd1306: ssd1306@3c {
            compatible = "solomon,ssd1306fb";
            reg = <0x3C>; /* I2C address of the display */
            width = <128>;
            height = <48>;
            segment-offset = <0>;
            page-offset = <0>;
            display-offset = <0>;
        };
    };
};
